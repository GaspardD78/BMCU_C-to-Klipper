## flash_automation/klipper_overrides/src/Kconfig.patch
```kconfig
diff --git a/src/Kconfig b/src/Kconfig
index 6740946..dcfda2b 100644
--- a/src/Kconfig
+++ b/src/Kconfig
@@ -10,6 +10,8 @@ config LOW_LEVEL_OPTIONS
 
 choice
     prompt "Micro-controller Architecture"
+    config MACH_CH32V20X
+        bool "WCH CH32V20x (RISC-V)"
     config MACH_AVR
         bool "Atmega AVR"
     config MACH_ATSAM
@@ -39,6 +41,7 @@ source "src/atsam/Kconfig"
 source "src/atsamd/Kconfig"
 source "src/lpc176x/Kconfig"
 source "src/stm32/Kconfig"
+source "src/ch32v20x/Kconfig"
 source "src/hc32f460/Kconfig"
 source "src/rp2040/Kconfig"
 source "src/pru/Kconfig"
```

## klipper-master/klipper-master/src/ch32v20x/Kconfig
```kconfig
if MACH_CH32V20X

config CH32V20X_SELECT
    bool
    default y
    select HAVE_GPIO
    select HAVE_GPIO_ADC
    select HAVE_GPIO_SPI
    select HAVE_GPIO_I2C
    select HAVE_GPIO_HARD_PWM
    select HAVE_STRICT_TIMING
    select HAVE_CHIPID

config BOARD_DIRECTORY
    string
    default "ch32v20x"

config MCU
    string "Modèle exact"
    default "ch32v203"

config CLOCK_FREQ
    int
    default 144000000

config FLASH_SIZE
    hex
    default 0x10000

config RAM_SIZE
    hex
    default 0x5000

choice
    prompt "Interface de communication"
config CH32V20X_SERIAL1
    bool "USART1 (PA9/PA10)"
    select SERIAL
config CH32V20X_USB
    bool "USB FS (PA11/PA12)" if LOW_LEVEL_OPTIONS
    select USBSERIAL
endchoice

endif
```

## klipper/src/ch32v20x/Kconfig
```kconfig
if MACH_CH32V20X

config CH32V20X_SELECT
    bool
    default y
    select HAVE_GPIO
    select HAVE_GPIO_ADC
    select WANT_ADC
    select HAVE_GPIO_SPI
    select HAVE_GPIO_I2C
    select HAVE_GPIO_HARD_PWM
    select HAVE_STRICT_TIMING
    select HAVE_CHIPID

config BOARD_DIRECTORY
    string
    default "ch32v20x"

config MCU
    string "Modèle exact"
    default "ch32v203"

config CLOCK_FREQ
    int
    default 144000000

config FLASH_SIZE
    hex
    default 0x10000

config RAM_SIZE
    hex
    default 0x5000

choice
    prompt "Interface de communication"
config CH32V20X_SERIAL1
    bool "USART1 (PA9/PA10)"
    select SERIAL
config SERIAL_BAUD
    int "Baud rate for serial port"
    default 250000
    depends on CH32V20X_SERIAL1
config CH32V20X_USB
    bool "USB FS (PA11/PA12)" if LOW_LEVEL_OPTIONS
    select USBSERIAL
endchoice

config HAVE_PWM_TIM1
    bool "Exposer les sorties PWM basées sur TIM1" if LOW_LEVEL_OPTIONS
    default y
    help
        Active les définitions de broches utilisant le timer avancé TIM1.
        Désactivez cette option si le design matériel ne câble aucune sortie
        sur TIM1 afin de réduire la consommation et le code généré.

config HAVE_PWM_TIM4
    bool "Exposer les sorties PWM basées sur TIM4" if LOW_LEVEL_OPTIONS
    default y
    help
        Active les définitions de broches utilisant TIM4. Désactivez cette
        option pour les cartes qui n'acheminent pas de PWM sur ce timer.

endif
```

## matrix_flow/klipper_overrides/src/Kconfig.patch
```kconfig
diff --git a/src/Kconfig b/src/Kconfig
index e1ecbdf9b..e696f5aaf 100644
--- a/src/Kconfig
+++ b/src/Kconfig
@@ -32,6 +32,8 @@ choice
         bool "Linux process"
     config MACH_SIMU
         bool "Host simulator"
+    config MACH_CH32V20X
+        bool "WCH CH32V20x (RISC-V)"
 endchoice

 source "src/avr/Kconfig"
@@ -45,6 +47,7 @@ source "src/pru/Kconfig"
 source "src/ar100/Kconfig"
 source "src/linux/Kconfig"
 source "src/simulator/Kconfig"
+source "src/ch32v20x/Kconfig"

 # Generic configuration options for serial ports
 config SERIAL
```
